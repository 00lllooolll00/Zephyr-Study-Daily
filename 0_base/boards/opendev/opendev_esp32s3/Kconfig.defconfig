## 1_kconfig/boards/opendev/opendev_esp32s3/board.yml
```yaml
board:
  name: opendev_esp32s3
  full_name: OpenDev ESP32-S3
  vendor: opendev
  socs:
  - name: esp32s3
```

## 1_kconfig/boards/opendev/opendev_esp32s3/opendev_esp32s3_procpu_defconfig
```kconfig
# 系统主频设置 (ESP32-S3 支持 240MHz)
CONFIG_SYS_CLOCK_HW_CYCLES_PER_SEC=240000000

# 开启串口和控制台
CONFIG_SERIAL=y
CONFIG_CONSOLE=y
CONFIG_UART_CONSOLE=y

# 开启 GPIO 支持
CONFIG_GPIO=y

CONFIG_ESP_SPIRAM=y
CONFIG_SPIRAM_MODE_OCT=y

# 堆大小
CONFIG_HEAP_MEM_POOL_SIZE=30240
```

## 3_device_tree_semantics/boards/opendev/opendev_esp32s3/Kconfig.opendev_esp32s3
```kconfig
config BOARD_OPENDEV_ESP32S3
	select SOC_ESP32S3_WROOM_N16R8
	select SOC_ESP32S3_PROCPU if BOARD_OPENDEV_ESP32S3_ESP32S3_PROCPU
	select SOC_ESP32S3_APPCPU if BOARD_OPENDEV_ESP32S3_ESP32S3_APPCPU
```

## 3_device_tree_semantics/dts/bindings/custom,cells-a.yaml
```yaml
description: Dummy binding file for learning Zephyr DTS
compatible: "custom,cells-a"

properties:
  dummy-value:
    type: int
phandle-array-of-ref-cells:
  - name-of-cell-one
  - name-of-cell-two
```

## 3_device_tree_semantics/dts/bindings/custom,cells-b.yaml
```yaml
description: Dummy binding file for learning Zephyr DTS
compatible: "custom,cells-b"

phandle-array-of-ref-cells:
  - name-of-cell-one
```
