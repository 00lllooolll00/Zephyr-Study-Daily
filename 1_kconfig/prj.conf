## CMakeLists.txt
```
cmake_minimum_required(VERSION 3.20.0)

list(APPEND BOARD_ROOT ${CMAKE_CURRENT_SOURCE_DIR})

find_package(Zephyr REQUIRED HINTS $ENV{ZEPHYR_BASE})
project(1_kconfig)
set(CMAKE_EXPORT_COMPILE_COMMANDS ON)

target_sources(app PRIVATE src/main.c)

# 只有 CONFIG_USER_FUNC 被定义了才会包含这个文件
target_sources_ifdef(CONFIG_USER_FUNC app PRIVATE
    src/user_func.c
)

target_compile_options(app PRIVATE
    -Wall
    -Wextra
    -g
)
```

## Kconfig
```
# 自定义我们的这个配置在 menuconfig 中显示的标题
mainmenu "Custom Menu for N1netyNine99"

# source 的作用就是引入Zephyr自身的顶层Kconfig
source "Kconfig.zephyr"

# 声明自定义菜单的分组
menu "Application Options"
config USER_FUNC
	bool "Enable a user fun"
	default n
	help
		Enables or disables user_fun function

endmenu
```

## prj.conf
```kconfig
# 对应 -O2 或 -O3
# CONFIG_SPEED_OPTIMIZATIONS=y
# 对应 -Og
CONFIG_DEBUG_OPTIMIZATIONS=y
# 对应 -O0
CONFIG_NO_OPTIMIZATIONS=y
# 对应 -Os 体积优化
# CONFIG_SIZE_OPTIMIZATIONS=y 

# gdb线程感知
CONFIG_DEBUG_THREAD_INFO=y

###############################

CONFIG_PRINTK=y
CONFIG_BOOT_BANNER=n
CONFIG_USER_FUNC=n
```

## src/main.c
```c
#include <zephyr/kernel.h>
#include <zephyr/sys/printk.h>

#ifdef CONFIG_USER_FUNC
#    include "user_func.h"
#endif

int main(void)
{
    while (1)
    {
        printk("hello zephyr!\n");
#ifdef CONFIG_USER_FUNC
        user_func();
#endif
        k_msleep(1000);
    }

    return 0;
}
```

## src/user_func.c
```c
#include "user_func.h"
#include <zephyr/kernel.h>

void user_func(void)
{
    printk("Custom func\n");
}
```

## src/user_func.h
```c
#ifndef USER_FUNC_H
#define USER_FUNC_H

void user_func(void);

#endif // USER_FUNC_H
```
